## meta-areadeltasat/conf/distro/areadeltasat-systemd.conf
```bitbake
#@TYPE: Distribution
#@NAME: ArEaDeLtA-SaT
#@DESCRIPTION: Embedded Linux Distribution Configuration for STB's

require areadeltasat-common.conf

DISTRO_VERSION = "home-systemd"

DISTRO_FEATURES_INITMAN = "systemd"
VIRTUAL-RUNTIME_init_manager = "${DISTRO_FEATURES_INITMAN}"
DISTRO_FEATURES += "systemd"
```

## meta-areadeltasat/conf/distro/areadeltasat.conf
```bitbake
#@TYPE: Distribution
#@NAME: ArEaDeLtA-SaT
#@DESCRIPTION: Embedded Linux Distribution Configuration for STB's

require areadeltasat-common.conf

VIRTUAL-RUNTIME_dev_manager = "busybox-mdev"
VIRTUAL-RUNTIME_login_manager = "busybox"
VIRTUAL-RUNTIME_init_manager = "sysvinit"
VIRTUAL-RUNTIME_initscripts = "initscripts"
```

## meta-areadeltasat/conf/layer.conf
```bitbake
# We have a conf and classes directory, append to BBPATH
BBPATH .= ":${LAYERDIR}"

# We have a recipes directory, add to BBFILES
BBFILES += "${LAYERDIR}/recipes-*/*/*.bb ${LAYERDIR}/recipes-*/*/*.bbappend"

BBFILE_COLLECTIONS += "areadeltasat-layer"
BBFILE_PATTERN_areadeltasat-layer := "^${LAYERDIR}/"
BBFILE_PRIORITY_areadeltasat-layer = "7"

AREADELTASAT_BASE := '${@os.path.normpath("${LAYERDIR}/../")}'
# Prevent current directory creeping into sstate objects. Otherwise, building
# in another TOPDIR will cause recipes using this variable to be rebuilt.
AREADELTASAT_BASE[vardepvalue] = 'meta-areadeltasat'

LICENSE_PATH += "${LAYERDIR}/licenses"
```

## meta-edision/conf/machine/include/edision-4k.inc
```bitbake
CHIPSET = "bcm72604"

BOX_BRAND = "edision"

require conf/distro/multilib.inc

require conf/machine/include/brahma-b53.inc
require conf/machine/include/build-extras.inc

MACHINE_ESSENTIAL_EXTRA_RDEPENDS += "\
    edision-dvb-modules-${MACHINE} \
    edision-resizerootfs \
    wlan-qcacld-20 \
    firmware-qca6174 \
    wireless-regdb-static \
"

MACHINE_ESSENTIAL_EXTRA_RRECOMMENDS += "\
    kernel-module-cdfs \
    kernel-module-rt2800usb \
"

MACHINE_EXTRA_RRECOMMENDS += "\
    enigma2-plugin-drivers-dvb-usb-opticombo \
    ${@bb.utils.contains("GST_VERSION", "1.0", "gstreamer1.0-plugin-dvbmediasink", "gst-plugin-dvbmediasink", d)} \
    edision-splash \
"

DVBMEDIASINK_CONFIG = "--with-wma --with-pcm --with-dtsdownmix --with-eac3 --with-h265 --with-vb9"

PREFERRED_VERSION_wireless-regdb = "2018.10.24"

PREFERRED_PROVIDER_virtual/blindscan-dvbs = "edision-blindscan-utils-${MACHINE}"
PREFERRED_PROVIDER_virtual/blindscan-dvbc = "edision-blindscan-utils-${MACHINE}"

PREFERRED_PROVIDER_virtual/kernel = "linux-edision"
PREFERRED_VERSION_linux-edision = "5.4.1"

PREFERRED_PROVIDER_virtual/egl = "libv3d-${MACHINE}"
PREFERRED_PROVIDER_virtual/libgles2 = "libv3d-${MACHINE}"

MTD_BOOTFS = "mmcblk1p1"
MTD_BLACK  = "mmcblk1"
MTD_KERNEL = "mmcblk1p2"
MTD_ROOTFS = "mmcblk1p3"
KERNEL_FILE = "kernel.bin"
ROOTFS_FILE = "rootfs.tar.bz2"

KERNEL_IMAGETYPE = "Image.gz"
KERNEL_CONSOLE = "ttyS0,115200n8"

MACHINE_FEATURES += "alsa 3dtv switchoff osdposition dvb-c blindscan-tbs blindscan-dvbs blindscan-dvbc satip mountboot videoenhancement multilib"

require conf/machine/include/autoload-filesystems.inc
require conf/machine/include/rootfs-emmc.inc
```

## meta-edision/conf/machine/include/edision-mipsel.inc
```bitbake
require conf/machine/include/bmips.inc
require conf/machine/include/build-extras.inc

MACHINE_ESSENTIAL_EXTRA_RDEPENDS += "os-dvb-modules-${MACHINE}"
MACHINE_ESSENTIAL_EXTRA_RDEPENDS += "rt8723bs"
MACHINE_ESSENTIAL_EXTRA_RRECOMMENDS += "kernel-module-hci-uart"
MACHINE_ESSENTIAL_EXTRA_RRECOMMENDS += "kernel-module-rt2800usb"

MACHINE_EXTRA_RRECOMMENDS += "enigma2-plugin-drivers-dvb-usb-opticombo"
MACHINE_EXTRA_RRECOMMENDS += "${@bb.utils.contains("GST_VERSION", "1.0", "gstreamer1.0-plugin-dvbmediasink", "gst-plugin-dvbmediasink", d)}"
MACHINE_EXTRA_RRECOMMENDS += "edision-splash"

DVBMEDIASINK_CONFIG = "--with-wma --with-wmv --with-pcm --with-dts --with-eac3"

PREFERRED_PROVIDER_virtual/kernel = "linux-os"

KERNEL_IMAGETYPE = "vmlinux.gz"
KERNEL_CONSOLE = "ttyS0,115200n8"

KERNEL_MODULE_AUTOLOAD += "r8723bs"
KERNEL_MODULE_AUTOLOAD += "hci_uart"

MACHINE_FEATURES += "alsa wlan 3dtv switchoff osdposition hdmicec textlcd dvb-c videoenhancement"

require conf/machine/include/autoload-filesystems.inc
require conf/machine/include/rootfs-ubi.inc
```

## meta-gi/conf/machine/et1x000.conf
```bitbake
#@TYPE: Machine
#@NAME: Galaxy Innovations ET11000
#@DESCRIPTION: Machine configuration for the Galaxy Innovations ET11000

require conf/machine/include/et1x000.inc

IMAGE_INSTALL_append += "\
    initrd-${MACHINE} \
    "

CHIPSET = "bcm7251s"

MACHINE_KERNEL_PR = "r0"

IMAGE_FSTYPES =+ "ext4"
```

## meta-gi/conf/machine/et7000mini.conf
```bitbake
#@TYPE: Machine
#@NAME: Galaxy Innovations ET-7000 Mini
#@DESCRIPTION: Machine configuration for the Galaxy Innovations ET-7000 Mini

CHIPSET = "bcm7362"

MACHINE_FEATURES += "textlcd dvb-c blindscan-dvbc"
MACHINE_KERNEL_PR = "r0"

require conf/machine/include/et7000mini.inc
```

## meta-gigablue/conf/machine/gb800se.conf
```bitbake
#@TYPE: Machine
#@NAME: GigaBlue 800 SE
#@DESCRIPTION: Machine configuration for GigaBlue 800 SE

IMAGEDIR = "gigablue/se"

require conf/machine/include/gigablue-gb7325.inc

MACHINE_FEATURES += "SCART smallflash"

FLASHSIZE = "64"

IMAGE_FSTYPES ?= "ubi"
UBI_VOLNAME = "rootfs"
MKUBIFS_ARGS = "-m 2048 -e 126976 -c 4096"
UBINIZE_ARGS = "-m 2048 -p 128KiB"
```

## meta-gigablue/conf/machine/gb800seplus.conf
```bitbake
#@TYPE: Machine
#@NAME: GigaBlue 800 SE Plus
#@DESCRIPTION: Machine configuration for GigaBlue 800 SE Plus

IMAGEDIR = "gigablue/seplus"

require conf/machine/include/gigablue-gb7358.inc

MACHINE_FEATURES += "blindscan-dvbc ci singlecore blindscan-dvbs YUV RCA"
```

## meta-gigablue/conf/machine/gb800solo.conf
```bitbake
#@TYPE: Machine
#@NAME: GigaBlue 800 Solo
#@DESCRIPTION: Machine configuration for GigaBlue 800 Solo

IMAGEDIR = "gigablue/solo"

require conf/machine/include/gigablue-gb7325.inc

MACHINE_FEATURES += "SCART middleflash"

FLASHSIZE = "128"

IMAGE_FSTYPES = "jffs2"

KERNEL_EXTRA_CMD = "--disable-compressor=lzo "

MKUBIFS_ARGS = " -e131072 -l -p125829120"
EXTRA_IMAGECMD_jffs2 = " -e131072 -l -p125829120"

MACHINE_ESSENTIAL_EXTRA_RDEPENDS += "\
    mtd-utils-jffs2 \
"

PREFERRED_VERSION_rtl8192cu = "3.3.0"
```

## meta-gigablue/conf/machine/gbquadplus.conf
```bitbake
#@TYPE: Machine
#@NAME: GigaBlue Quad Plus
#@DESCRIPTION: Machine configuration for GigaBlue Quad Plus

IMAGEDIR = "gigablue/quadplus"

require conf/machine/include/gigablue-gb7356.inc

MACHINE_FEATURES += "colorlcd400 gbwol gigabluelcd400"
```

## meta-gigablue/conf/machine/gbtrio4k.conf
```bitbake
#@TYPE: Machine
#@NAME: GigaBlue Trio 4K
#@DESCRIPTION: Machine configuration for GigaBlue Trio 4K

IMAGEDIR = "gigablue/trio4k"

EXTRA_OECONF_append_pn-enigma2 = "--with-lcddev=/dev/null --with-alphablendingacceleration=always --with-blitaccelerationthreshold=250  --with-fillaccelerationthreshold=190000"

MACHINE_FEATURES += "multitranscoding"

SOC_FAMILY = "hisi3798mv200"

require conf/machine/include/gigablue-mv200.inc

MACHINE_ESSENTIAL_EXTRA_RDEPENDS += "\
    gigablue-partitions-gbmv200 \
"
```

## meta-gigablue/conf/machine/include/gigablue-gb72604.inc
```bitbake
require conf/machine/include/gigablue-arm.inc

MACHINE_EXTRA_RRECOMMENDS = " \
    ${@bb.utils.contains("GST_VERSION", "1.0", "gstreamer1.0-plugin-dvbmediasink", "gst-plugin-dvbmediasink", d)} \
    ntfs-3g \
"

### Logitech keyboard ###
KERNEL_MODULE_AUTOLOAD += "hid-logitech"
KERNEL_MODULE_AUTOLOAD += "hid-logitech-dj"

DVBSKYPROVIDER = "kernel"

MACHINE_FEATURES += "colorlcd gigabluelcd gigabluelcd220 mmc ci omb blindscan-dvbs blindscan-dvbc transcoding dvb-c mountboot bluetooth"

CHIPSET = "bcm72604"

MTD_KERNEL = "mmcblk0p4"
MTD_ROOTFS = "mmcblk0p5"
MTD_BLACK  = "mmcblk0"

SRCDATE_BOLT = "20190926"

PREFERRED_VERSION_linux-gigablue = "4.1.20"
PREFERRED_PROVIDER_virtual/kernel = "linux-gigablue"
PREFERRED_PROVIDER_virtual/egl = "gb-v3ddriver-gb72604"
PREFERRED_PROVIDER_virtual/libgles2 = "gb-v3ddriver-gb72604"

PACKAGECONFIG_GL_pn-qtbase = " gles2 eglfs linuxfb"

IMGDEPLOYDIR ?= "${DEPLOY_DIR_IMAGE}"

IMAGE_CMD_tar_prepend = "\
    mkdir -p ${IMGDEPLOYDIR}/${IMAGEDIR}; \
    cp ${DEPLOY_DIR_IMAGE}/${MACHINE}_boot.bin ${IMGDEPLOYDIR}/${IMAGEDIR}/boot.bin; \
    cp ${DEPLOY_DIR_IMAGE}/${MACHINE}_gpt.bin ${IMGDEPLOYDIR}/${IMAGEDIR}/gpt.bin; \
    cp ${DEPLOY_DIR_IMAGE}/${MACHINE}_rescue.bin ${IMGDEPLOYDIR}/${IMAGEDIR}/rescue.bin; \
    ${@bb.utils.contains("MACHINE_FEATURES", "bolt", "cp ${DEPLOY_DIR_IMAGE}/${MACHINE}_bolt_${SRCDATE_BOLT}.bin ${DEPLOY_DIR_IMAGE}/${IMAGEDIR}/bolt_${SRCDATE_BOLT}.bin;" , "", d)} \
    cp ${DEPLOY_DIR_IMAGE}/zImage ${IMGDEPLOYDIR}/${IMAGEDIR}/kernel.bin; \
    echo ${IMAGE_NAME} > ${IMGDEPLOYDIR}/${IMAGEDIR}/imageversion; \
    cd ${IMAGE_ROOTFS}; \
    tar -cvf ${IMGDEPLOYDIR}/rootfs.tar -C ${IMAGE_ROOTFS} .; \
    mv ${IMGDEPLOYDIR}/rootfs.tar ${IMGDEPLOYDIR}/${IMAGEDIR}/rootfs.tar; \
    bzip2 ${IMGDEPLOYDIR}/${IMAGEDIR}/rootfs.tar; \
    cd ${IMGDEPLOYDIR}; \
    zip ${IMAGE_NAME}_usb.zip ${IMAGEDIR}/*; \
    rm -Rf gigablue; \
"

MACHINE_ESSENTIAL_EXTRA_RDEPENDS = " \
    gigablue-platform-util-gb72604 \
    gigablue-ddbootup \
    gigablue-swapcreate \
"

MACHINE_ESSENTIAL_EXTRA_RRECOMMENDS = " \
    gb-v3ddriver-gb72604 \
    gb-qteglfs-platform \
    "

EXTRA_IMAGEDEPENDS = "\
    gigablue-initrd-cfe-${MACHINE} \
    "

IMAGE_INSTALL_append += "\
    bluetoothsetup-gb72604 \
    "
```

## meta-gigablue/conf/machine/include/gigablue-gb7325.inc
```bitbake
SOC_FAMILY = "bcm7325"

require gigablue-mips.inc

MACHINE_FEATURES += "singlecore blindscan-dvbc ci YUV RCA"

PREFERRED_VERSION_linux-gigablue = "3.9.6"
PREFERRED_VERSION_samba = "3.6.25"

MACHINE_ESSENTIAL_EXTRA_RDEPENDS += "\
    gigablue-dvb-modules-gb7325 \
"

DVBMEDIASINK_CONFIG = "--with-wmv"

GLIBC_EXTRA_OECONF = "--with-tls"
```

## meta-gigablue/conf/machine/include/gigablue-gb7356.inc
```bitbake
SOC_FAMILY = "bcm7356"

require gigablue-mips.inc

MACHINE_FEATURES += "gigabluelcd blindscan-dvbc transcoding ci gigabluemipsbootvideo osdanimation blindscan-dvbs YUV RCA"

### Logitech keyboard ###
KERNEL_MODULE_AUTOLOAD += "hid-logitech"
KERNEL_MODULE_AUTOLOAD += "hid-logitech-dj"

DVBSKYPROVIDER = "kernel"

PREFERRED_VERSION_linux-gigablue = "4.8.3"

IMAGE_FSTYPES ?= "ubi"
UBI_VOLNAME = "rootfs"
MKUBIFS_ARGS = "-m 2048 -e 126976 -c 4096 -F"
UBINIZE_ARGS = "-m 2048 -p 128KiB"

MACHINE_ESSENTIAL_EXTRA_RDEPENDS += "\
    gigablue-dvb-modules-gb7356 \
"

DVBMEDIASINK_CONFIG = "--with-wmv --with-wma --with-pcm --with-dts --with-eac3 --with-amr"

GLIBC_EXTRA_OECONF = "--with-tls --with-__thread"
```

## meta-gigablue/conf/machine/include/gigablue-gb7358.inc
```bitbake
SOC_FAMILY = "bcm7358"

require gigablue-mips.inc

MACHINE_FEATURES += "videoenhancement gbsoftwol osdanimation middleflash"

# Broken bootloader can only flash around 100 MB
FLASHSIZE = "96"

### Logitech keyboard ###
KERNEL_MODULE_AUTOLOAD += "hid-logitech"
KERNEL_MODULE_AUTOLOAD += "hid-logitech-dj"

DVBSKYPROVIDER = "kernel"

PREFERRED_VERSION_linux-gigablue = "4.8.3"
PREFERRED_VERSION_samba = "3.6.25"

IMAGE_FSTYPES ?= "ubi"
UBI_VOLNAME = "rootfs"
MKUBIFS_ARGS = "-m 2048 -e 126976 -c 4096"
UBINIZE_ARGS = "-m 2048 -p 128KiB"

MACHINE_ESSENTIAL_EXTRA_RDEPENDS += "\
    gigablue-dvb-modules-gb7358 \
"

DVBMEDIASINK_CONFIG = "--with-wmv --with-wma --with-pcm --with-dts --with-eac3 --with-amr"

GLIBC_EXTRA_OECONF = "--with-tls --with-__thread"
```

## meta-gigablue/conf/machine/include/gigablue-gb7362.inc
```bitbake
SOC_FAMILY = "bcm7362"

require gigablue-mips.inc

MACHINE_FEATURES += "gbsoftwol osdanimation blindscan-dvbs middleflash"

# Broken bootloader can only flash around 100 MB
FLASHSIZE = "96"

### Logitech keyboard ###
KERNEL_MODULE_AUTOLOAD += "hid-logitech"
KERNEL_MODULE_AUTOLOAD += "hid-logitech-dj"

DVBSKYPROVIDER = "kernel"

PREFERRED_VERSION_linux-gigablue = "4.8.3"

IMAGE_FSTYPES ?= "ubi"
UBI_VOLNAME = "rootfs"
MKUBIFS_ARGS = "-m 2048 -e 126976 -c 4096"
UBINIZE_ARGS = "-m 2048 -p 128KiB"

MACHINE_ESSENTIAL_EXTRA_RDEPENDS += "\
    gigablue-dvb-modules-gb7362 \
"

DVBMEDIASINK_CONFIG = "--with-wmv --with-wma --with-pcm --with-dts --with-eac3 --with-amr"

GLIBC_EXTRA_OECONF = "--with-tls --with-__thread"
```

## meta-gigablue/conf/machine/include/gigablue-mips.inc
```bitbake
require conf/machine/include/gigablue-oem.inc

TARGET_ARCH = "mipsel"
DEFAULTTUNE = "mips32el"
KERNEL_IMAGETYPE = "vmlinux"

PREFERRED_PROVIDER_virtual/blindscan-dvbc = "gigablue-blindscan-utils-mips"
PREFERRED_PROVIDER_virtual/blindscan-dvbs = "gigablue-blindscan-utils-mips"

IMAGE_CMD_ubi_prepend = "\
    rm -rf ${IMAGE_ROOTFS}/boot/*; \
    rm -rf ${IMAGE_ROOTFS}/tmp/*; \
    "

IMAGE_CMD_ubi_append = "\
    mkdir -p ${DEPLOY_DIR_IMAGE}/${IMAGEDIR}; \
    ${@bb.utils.contains("MACHINE_FEATURES", "gigabluelcd220", "cp ${DEPLOY_DIR_IMAGE}/lcdwarning220.bin ${DEPLOY_DIR_IMAGE}/${IMAGEDIR}/lcdwarning.bin;" , "", d)} \
    ${@bb.utils.contains("MACHINE_FEATURES", "gigabluelcd220", "cp ${DEPLOY_DIR_IMAGE}/lcdwaitkey220.bin ${DEPLOY_DIR_IMAGE}/${IMAGEDIR}/lcdwaitkey.bin;" , "", d)} \
    ${@bb.utils.contains("MACHINE_FEATURES", "gigabluelcd400", "cp ${DEPLOY_DIR_IMAGE}/lcdwarning400.bin ${DEPLOY_DIR_IMAGE}/${IMAGEDIR}/lcdwarning.bin;" , "", d)} \
    ${@bb.utils.contains("MACHINE_FEATURES", "gigabluelcd400", "cp ${DEPLOY_DIR_IMAGE}/lcdwaitkey400.bin ${DEPLOY_DIR_IMAGE}/${IMAGEDIR}/lcdwaitkey.bin;" , "", d)} \
    cp ${DEPLOY_DIR_IMAGE}/warning.bin ${DEPLOY_DIR_IMAGE}/${IMAGEDIR}/warning.bin; \
    mv ${IMGDEPLOYDIR}/${IMAGE_NAME}${IMAGE_NAME_SUFFIX}.ubi ${DEPLOY_DIR_IMAGE}/${IMAGEDIR}/${ROOTFS_FILE}; \
    gzip -f -c ${DEPLOY_DIR_IMAGE}/vmlinux-${MACHINE}.bin > ${DEPLOY_DIR_IMAGE}/${IMAGEDIR}/${KERNEL_FILE}; \
    echo ${IMAGE_NAME} > ${DEPLOY_DIR_IMAGE}/${IMAGEDIR}/imageversion; \
    echo "rename this file to 'force' to force an update without confirmation" > ${DEPLOY_DIR_IMAGE}/${IMAGEDIR}/noforce; \
    rm -f ${DEPLOY_DIR_IMAGE}/*.zip; \
    cd ${DEPLOY_DIR_IMAGE}; \
    zip -r ${IMAGE_NAME}_usb.zip gigablue/*; \
    rm -f ${DEPLOY_DIR_IMAGE}/*.ubi; \
    rm -f ${DEPLOY_DIR_IMAGE}/*.ubifs; \
    rm -f ${DEPLOY_DIR_IMAGE}/*.manifest; \
    rm -rf ${DEPLOY_DIR_IMAGE}/gigablue; \
    "

IMAGE_CMD_jffs2_prepend = "\
    rm -rf ${IMAGE_ROOTFS}/boot/*; \
    rm -rf ${IMAGE_ROOTFS}/tmp/*; \
    "

IMAGE_CMD_jffs2_append = "; \
    mkdir -p ${DEPLOY_DIR_IMAGE}/${IMAGEDIR}; \
    mv ${IMGDEPLOYDIR}/${IMAGE_NAME}${IMAGE_NAME_SUFFIX}.jffs2 ${DEPLOY_DIR_IMAGE}/${IMAGEDIR}/${ROOTFS_FILE}; \
    gzip -f -c ${DEPLOY_DIR_IMAGE}/vmlinux-${MACHINE}.bin > ${DEPLOY_DIR_IMAGE}/${IMAGEDIR}/${KERNEL_FILE}; \
    echo "rename this file to 'force' to force an update without confirmation" > ${DEPLOY_DIR_IMAGE}/${IMAGEDIR}/noforce; \
    echo ${IMAGE_NAME} > ${DEPLOY_DIR_IMAGE}/${IMAGEDIR}/imageversion; \
    rm -f ${DEPLOY_DIR_IMAGE}/*.zip; \
    cd ${DEPLOY_DIR_IMAGE}; \
    zip -r ${IMAGE_NAME}_usb.zip gigablue/*; \
    zip ${IMAGE_NAME}_usb.zip burn.bat; \
    rm -f ${DEPLOY_DIR_IMAGE}/*.jffs2; \
    rm -f ${DEPLOY_DIR_IMAGE}/*.manifest; \
    rm -rf ${DEPLOY_DIR_IMAGE}/gigablue; \
    "

require conf/machine/include/tune-mips32.inc
```
