## meta-gigablue/conf/machine/include/gigablue-mv200.inc
```bitbake
require conf/machine/include/gigablue-oem.inc

MTD_KERNEL = "mmcblk0p12"
MTD_ROOTFS = "mmcblk0p13"
MTD_BLACK  = "mmcblk0"

DISTRO_FEATURES_remove = "x11 wayland"

MACHINE_ESSENTIAL_EXTRA_RDEPENDS += "\
    gigablue-dvb-modules-${MACHINE} \
    gigablue-loadmodules-gbmv200 \ 
    gigablue-libs-gbmv200 \
    gigablue-hihalt-gbmv200 \
    gigablue-reader-gbmv200 \
    gigablue-libreader-gbmv200 \
    gigablue-buildimage \
    e2fsprogs-resize2fs \
    gptfdisk \
"

MACHINE_FEATURES += "switchoff 7segment hdmicec textlcd emmc mmc blindscan-dvbs alsa hisi"

IMAGE_CLASSES  += "gigablue-emmc_image"
IMAGE_FSTYPES += "gigablueemmc"
IMAGE_ROOTFS_SIZE ?= "524288"

TARGET_ARCH = "arm"
DEFAULTTUNE = "cortexa15hf-neon-vfpv4"

PREFERRED_VERSION_linux-gigablue = "4.4.35"
PREFERRED_PROVIDER_virtual/blindscan-dvbs = "gigablue-blindscan-gbmv200"
PREFERRED_RPROVIDER_showiframe = "gigablue-showiframe-gbmv200"
PREFERRED_RPROVIDER_aio-grab = "gigablue-grab-gbmv200"
PREFERRED_PROVIDER_virtual/enigma2-mediaservice ?= "enigma2-plugin-systemplugins-servicehisilicon"
PREFERRED_VERSION_ffmpeg = "3.4.2"

require conf/machine/include/tune-cortexa15.inc

DVBSKYPROVIDER = "kernel"

DVBMEDIASINK_CONFIG = "--with-h265 --with-vb8 --with-vb9 --with-spark --with-wma --with-wmv --with-pcm --with-dts --with-eac3"

IMAGE_CMD_gigablueemmc_append = "\
    mkdir -p ${DEPLOY_DIR_IMAGE}/${IMAGEDIR}; \
    cp ${IMGDEPLOYDIR}/${IMAGE_NAME}${IMAGE_NAME_SUFFIX}.ext4 ${DEPLOY_DIR_IMAGE}/${MACHINE}-partitions/rootfs.ext4; \
    cd ${IMAGE_ROOTFS}; \
    tar -cvf ${DEPLOY_DIR_IMAGE}/rootfs.tar -C ${IMAGE_ROOTFS} .; \
    mv ${DEPLOY_DIR_IMAGE}/rootfs.tar ${DEPLOY_DIR_IMAGE}/${IMAGEDIR}/rootfs.tar; \
    bzip2 ${DEPLOY_DIR_IMAGE}/${IMAGEDIR}/rootfs.tar; \
    cp ${DEPLOY_DIR_IMAGE}/uImage ${DEPLOY_DIR_IMAGE}/${IMAGEDIR}/${KERNEL_FILE}; \
    cp ${DEPLOY_DIR_IMAGE}/uImage ${DEPLOY_DIR_IMAGE}/${MACHINE}-partitions/${KERNEL_FILE}; \
    echo ${IMAGE_NAME} > ${DEPLOY_DIR_IMAGE}/${IMAGEDIR}/imageversion; \
    cd ${DEPLOY_DIR_IMAGE}/${MACHINE}-partitions; \
    mkupdate -s 00000003-00000001-01010101 -f ${DEPLOY_DIR_IMAGE}/${MACHINE}-partitions/emmc_partitions.xml -d ${DEPLOY_DIR_IMAGE}/usb_update.bin; \
    rm -f ${DEPLOY_DIR_IMAGE}/*.zip; \
    cd ${DEPLOY_DIR_IMAGE}; \
    zip ${IMAGE_NAME}_mmc.zip ${IMAGEDIR}/*; \
    zip -j ${IMAGE_NAME}_mmc.zip ${DEPLOY_DIR_IMAGE}/usb_update.bin ${DEPLOY_DIR_IMAGE}/${MACHINE}-partitions/bootargs.bin ${DEPLOY_DIR_IMAGE}/${MACHINE}-partitions/fastboot.bin ${DEPLOY_DIR_IMAGE}/${MACHINE}-partitions/apploader.bin; \
    rm -f ${DEPLOY_DIR_IMAGE}/*.ext4; \
    rm -f ${DEPLOY_DIR_IMAGE}/*.manifest; \
    rm -f ${DEPLOY_DIR_IMAGE}/*.json; \
    rm -Rf ${DEPLOY_DIR_IMAGE}/usb_update.bin; \
    rm -Rf ${IMAGEDIR}; \
    "
```

## meta-gigablue/conf/machine/include/gigablue-oem.inc
```bitbake
# We know about rtc
include conf/machine/include/build-extras.inc

BOX_BRAND = "gigablue"

MTD_KERNEL = "mtd2"
MTD_ROOTFS = "mtd0"

KERNEL_FILE = "kernel.bin"
ROOTFS_FILE = "rootfs.bin"

MACHINE_ESSENTIAL_EXTRA_RDEPENDS += "\
    gigablue-ddbootup \
    enigma2-plugin-systemplugins-vfdcontrol \
    kernel-module-rtl8192cu \
    firmware-rtl8192cu \
    firmware-rtl8192cufw \
    rtl8192eu \
    firmware-rtl8192eu \
    rt8812au \
    rt8822bu \
    "

DVBPROVIDER = "kernel"

MACHINE_ESSENTIAL_EXTRA_RRECOMMENDS += "\
    kernel-module-cdfs \
    kernel-module-zram \
    kernel-module-ext2 \
    kernel-module-ext3 \
    kernel-module-ext4 \
    kernel-module-cifs \
    kernel-module-autofs4 \
    "

MACHINE_EXTRA_RRECOMMENDS += "\
    gstreamer1.0-plugin-dvbmediasink \
    ${@bb.utils.contains_any("MACHINE", "gbipbox gb800seplus gb800ueplus gb800se gb800ue gb800solo", "", "gstreamer1.0-libav", d)} \
    ${@bb.utils.contains("MACHINE_FEATURES", "hisi", "" , "gigablue-cfe", d)} \
    "

include conf/machine/include/autoload-filesystems.inc

PREFERRED_PROVIDER_virtual/kernel = "linux-gigablue"

KERNEL_OUTPUT = "${KERNEL_IMAGETYPE}"
KERNEL_CONSOLE = "ttyS0,115200n8"

MACHINE_FEATURES += "3dtv alsa hdmicec switchoff blindscan-tbs gigablue"

BOOTLOGO_FILENAME = "splash.bin"

require conf/machine/include/soc-family.inc
```

## meta-miraclebox/conf/machine/mbmicro.conf
```bitbake
#@TYPE: Machine
#@NAME: Miraclebox
#@DESCRIPTION: Machine configuration for the Miraclebox Premium Micro

IMAGEDIR ?= "miraclebox/micro"

PREFERRED_VERSION_linux-${MACHINE} = "4.0.1"

MKUBIFS_ARGS = "-m 2048 -e 126976 -c 8192"
UBINIZE_ARGS = "-m 2048 -p 128KiB"

MACHINE_FEATURES += "dvb-c blindscan-dvbc blindscan-dvbs"

CHIPSET = "bcm7362"

require conf/machine/include/miraclebox.inc
```

## meta-miraclebox/conf/machine/mbmicrov2.conf
```bitbake
#@TYPE: Machine
#@NAME: Miraclebox
#@DESCRIPTION: Machine configuration for the Miraclebox Premium Micro v2

IMAGEDIR ?= "miraclebox/microv2"

PREFERRED_VERSION_linux-${MACHINE}= "4.10.12"
PREFERRED_VERSION_linux-libc-headers = "4.10"

MKUBIFS_ARGS = "-m 2048 -e 126976 -c 8192"
UBINIZE_ARGS = "-m 2048 -p 128KiB"

MACHINE_FEATURES += "dvb-c blindscan-dvbc blindscan-dvbs linuxwifi AV_JACK"

CHIPSET = "bcm73625"

require conf/machine/include/miraclebox.inc
```

## meta-octagon/conf/machine/sf8008.conf
```bitbake
#@TYPE: Machine
#@NAME: sf8008
#@DESCRIPTION: Machine configuration for the sf8008

EXTRA_OECONF_append_pn-enigma2 = "--with-lcddev=/dev/null --with-alphablendingacceleration=always --with-blitaccelerationthreshold=250  --with-fillaccelerationthreshold=190000"

MACHINE_FEATURES += " textlcd 7segment blindscan dvb-c hisil mali"
AREADELTASAT_FEATURES += " qtplugins kodi"
DISTRO_FEATURES_remove = "x11 wayland directfb"

CHIPSET = "Hi3798Mv200"

require conf/machine/include/octagon-hisi.inc
```

## meta-qviart/conf/machine/lunix.conf
```bitbake
#@TYPE: Machine
#@NAME: qviart
#@DESCRIPTION: Machine configuration for the qviart lunix

IMAGEDIR ?= "update/lunix/cfe"

BRANDTYPE = "QVIART"

CHIPSET = "bcm73625"

require conf/machine/include/qviart.inc
```

## meta-qviart/conf/machine/lunix3-4k.conf
```bitbake
#@TYPE: Machine
#@NAME: qviart Lunix3-4k galaxy4k
#@DESCRIPTION: Machine configuration for the Lunix3-4k.

CHIP = "7252S"

UPDATE_DIR = "lunix3-4k"

require conf/machine/include/qviart4k.inc

KV = "linux-3.14-28"

MACHINE_FEATURES += "textlcd dvbproxy dvb-c transcoding streamproxy"

CHIPSET = "bcm7439"

MODEL_SIZE = "300mm"

FORCE_REBOOT_OPTION = "reboot"

MACHINE_KERNEL_PR = "r1"

IMAGE_FSTYPES =+ "ext4"

MACHINE_ESSENTIAL_EXTRA_RDEPENDS += " \
	qviart-dvb-modules-bcm7252s-${MODEL_SIZE} \
"

PREFERRED_VERSION_linux-qviart = "3.14.28"
```
