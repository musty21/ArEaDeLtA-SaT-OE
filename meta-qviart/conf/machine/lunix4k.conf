## meta-qviart/conf/machine/lunix4k.conf
```bitbake
#@TYPE: Machine
#@NAME: qviart lunix 4k (72604)
#@DESCRIPTION: Machine configuration for the lunix 4k.
#

CHIP = "72604"

UPDATE_DIR = "lunix4k"

require conf/machine/include/qviart4k.inc

MACHINE_FEATURES += "proxy v3d swap dvb-c textlcd"
OPENPLI_FEATURES += "kodi"

KV = "linux-4.1.20"

CHIPSET = "bcm72604"

FORCE_REBOOT_OPTION = "reboot"

MACHINE_KERNEL_PR = "r1"

IMAGE_FSTYPES =+ "ext4"

PREFERRED_VERSION_linux-qviart = "4.1.20"

PREFERRED_PROVIDER_virtual/mesa ?= "mesa"
PREFERRED_PROVIDER_virtual/egl = "v3d-libgles-${CHIP}" 
PREFERRED_PROVIDER_virtual/libgles2 = "v3d-libgles-${CHIP}"

EXTRA_OECONF_append_pn-kodi = " --with-gpu=v3d"

MACHINE_ESSENTIAL_EXTRA_RDEPENDS += " \
	${@bb.utils.contains("MACHINE_FEATURES", "proxy", "platform-util-${CHIP} qviart-dvb-modules-proxy${CHIP}", "", d)} \
	${@bb.utils.contains("MACHINE_FEATURES", "v3d", "v3d-libgles-${CHIP}","", d)} \
	${@bb.utils.contains("MACHINE_FEATURES", "swap", "swapcreate-${CHIP}", "", d)} \
"
```

## meta-qviart/conf/machine/lunixco.conf
```bitbake
#@TYPE: Machine
#@NAME: qviart
#@DESCRIPTION: Machine configuration for the qviart lunixco

IMAGEDIR ?= "update/lunixco/cfe"

BRANDTYPE = "QVIART"

CHIPSET = "bcm73625"

require conf/machine/include/qviart.inc
```
